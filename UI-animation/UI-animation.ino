#include <SPI.h>
#include <Adafruit_GFX.h>
#include <Adafruit_ST7735.h> // ST7735 128x160 TFT
#include <pgmspace.h>
#include "frames_rgb565.h"   // generated by your Python script

// ---- TFT Pins ----
#define TFT_CS   5
#define TFT_DC   4
#define TFT_RST  2
// (Hardware SPI on ESP32 uses SCLK=18, MOSI=23 by default)

// ---- TFT Setup ----
Adafruit_ST7735 tft(TFT_CS, TFT_DC, TFT_RST);

// ---- Animation timing ----
const int FPS = 8;                            // try 20–30
const uint32_t FRAME_INTERVAL = 1000 / FPS;
uint32_t lastFrameMs = 0;
uint16_t frameIdx = 0;

// ---- Rendering ----
static uint16_t lineBuf[128];                  // one scanline buffer (fits 128px width)

// Adafruit expects MSB-first over SPI, so swap from 0xRRRR (LE) to BE
static inline uint16_t swap16(uint16_t v) { return (v << 8) | (v >> 8); }

void drawFrameLineFromProgmem(const uint16_t* frameProgmem, int x, int y, int lineY) {
  // Read one line from PROGMEM, convert to big-endian, push
  for (int i = 0; i < FRAME_W; i++) {
    uint16_t px = pgm_read_word(&frameProgmem[lineY * FRAME_W + i]);
    lineBuf[i] = swap16(px);
  }
  tft.startWrite();
  tft.setAddrWindow(x, y + lineY, FRAME_W, 1);
  tft.writePixels(lineBuf, FRAME_W, true);
  tft.endWrite();
}

void drawFrame(uint16_t idx, int x, int y) {
  // FRAMES[] is in PROGMEM; read its pointer, then stream lines
  const uint16_t* frame = (const uint16_t*)pgm_read_ptr(&FRAMES[idx % FRAME_COUNT]);
  for (int ly = 0; ly < FRAME_H; ly++) {
    drawFrameLineFromProgmem(frame, x, y, ly);
  }
}

void setup() {
  // Init TFT
  tft.initR(INITR_BLACKTAB);   // most ST7735S modules
  tft.setRotation(0);          // adjust if you want landscape
 
  tft.fillScreen(ST77XX_BLACK);
  tft.setSPISpeed(40000000);   // push SPI faster (optional, helps fps)

  // (Optional) flash test frame so you immediately see something:
  // int16_t x = (tft.width()  - FRAME_W) / 2;   // 0 for 128x128 on 128-wide
  // int16_t y = (tft.height() - FRAME_H) / 2;   // 16 to center vertically
  // drawFrame(0, x, y);
}

void loop() {
  static const int16_t X = (int16_t)((int)tft.width()  - FRAME_W) / 2;  // 128-128=0
  static const int16_t Y = (int16_t)((int)tft.height() - FRAME_H) / 2;  // 160-128=16

  uint32_t now = millis();
  if (now - lastFrameMs >= FRAME_INTERVAL) {
    lastFrameMs = now;

    // draw next frame centered; background stays black outside 128x128
    drawFrame(frameIdx, X, Y);
    frameIdx = (frameIdx + 1) % FRAME_COUNT;
  }
}
